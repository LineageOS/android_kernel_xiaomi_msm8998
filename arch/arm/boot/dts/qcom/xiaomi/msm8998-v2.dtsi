/* Copyright (c) 2016, The Linux Foundation. All rights reserved.
 *
 * This program is free software; you can redistribute it and/or modify
 * it under the terms of the GNU General Public License version 2 and
 * only version 2 as published by the Free Software Foundation.
 *
 * This program is distributed in the hope that it will be useful,
 * but WITHOUT ANY WARRANTY; without even the implied warranty of
 * MERCHANTABILITY or FITNESS FOR A PARTICULAR PURPOSE.  See the
 * GNU General Public License for more details.
 */

#include "msm8998.dtsi"

&qusb_phy0 {
	reg = <0x0c012000 0x2a8>,
	      <0x01fcb24c 0x4>;
	reg-names = "qusb_phy_base",
			"tcsr_clamp_dig_n_1p8";
};

