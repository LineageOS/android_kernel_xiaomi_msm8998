/* Copyright (c) 2015, The Linux Foundation. All rights reserved.
 * Copyright (C) 2017 XiaoMi, Inc.
 *
 * This program is free software; you can redistribute it and/or modify
 * it under the terms of the GNU General Public License version 2 and
 * only version 2 as published by the Free Software Foundation.
 *
 * This program is distributed in the hope that it will be useful,
 * but WITHOUT ANY WARRANTY; without even the implied warranty of
 * MERCHANTABILITY or FITNESS FOR A PARTICULAR PURPOSE.  See the
 * GNU General Public License for more details.
 */

/*---------------------------------------------------------------------------
 * This file is autogenerated file using gcdb parser. Please do not edit it.
 * Update input XML file to add a new entry or update variable in this file
 * VERSION = "1.0"
 *---------------------------------------------------------------------------*/
&soc {
	dsi_jdi_fhd_nt35596s_pro_video: qcom,mdss_dsi_jdi_fhd_nt35596s_pro_video {
		qcom,mdss-dsi-panel-name = "jdi fhd video dsi panel";
		qcom,mdss-dsi-panel-id = <0>;
		qcom,mdss-dsi-panel-model = "JDI FHD NT35596S VIDEO PANEL";
		qcom,mdss-dsi-panel-sleepwrmod = <0>;
		qcom,mdss-dsi-panel-type = "dsi_video_mode";
		qcom,mdss-dsi-panel-framerate = <60>;
		qcom,mdss-dsi-virtual-channel-id = <0>;
		qcom,mdss-dsi-stream = <0>;
		qcom,mdss-dsi-panel-width = <1080>;
		qcom,mdss-dsi-panel-height = <2160>;
		qcom,mdss-dsi-h-front-porch = <12>;
		qcom,mdss-dsi-h-back-porch = <40>;
		qcom,mdss-dsi-h-pulse-width = <24>;
		qcom,mdss-dsi-h-sync-skew = <0>;
		qcom,mdss-dsi-v-back-porch = <24>;
		qcom,mdss-dsi-v-front-porch = <6>;
		qcom,mdss-dsi-v-pulse-width = <4>;
		qcom,mdss-dsi-h-left-border = <0>;
		qcom,mdss-dsi-h-right-border = <0>;
		qcom,mdss-dsi-v-top-border = <0>;
		qcom,mdss-dsi-v-bottom-border = <0>;
		qcom,mdss-dsi-bpp = <24>;
		qcom,mdss-dsi-color-order = <0>;
		qcom,mdss-dsi-underflow-color = <0x0>;
		qcom,mdss-dsi-border-color = <0>;
		qcom,mdss-dsi-on-command = [
				15 01 00 00 00 00 02 FF 24
				15 00 00 00 00 00 02 9D 34
				15 00 00 00 00 00 02 FB 01
				15 00 00 00 00 00 02 C4 25
				15 00 00 00 00 00 02 D1 08
				15 00 00 00 00 00 02 D2 84
				15 01 00 00 00 00 02 FF 26
				15 00 00 00 00 00 02 FB 01
				15 00 00 00 00 00 02 03 1C
				15 00 00 00 00 00 02 3B 08
				15 00 00 00 00 00 02 6B 08
				15 00 00 00 00 00 02 97 08
				15 00 00 00 00 00 02 C5 08
				15 00 00 00 00 00 02 FB 01
				15 01 00 00 00 00 02 FF 23
				15 00 00 00 00 00 02 FB 01
				15 00 00 00 00 00 02 01 84
				15 00 00 00 00 00 02 05 2D
				15 00 00 00 00 00 02 06 00
				15 00 00 00 00 00 02 33 07
				15 00 00 00 00 00 02 21 EE
				15 00 00 00 00 00 02 22 ED
				15 00 00 00 00 00 02 23 EA
				15 00 00 00 00 00 02 24 E8
				15 00 00 00 00 00 02 25 E5
				15 00 00 00 00 00 02 26 E2
				15 00 00 00 00 00 02 27 DE
				15 00 00 00 00 00 02 28 BB
				15 00 00 00 00 00 02 29 87
				15 00 00 00 00 00 02 2A 77
				15 01 00 00 00 00 02 32 0C
				15 00 00 00 00 00 02 13 3F
				15 00 00 00 00 00 02 14 34
				15 00 00 00 00 00 02 15 2A
				15 00 00 00 00 00 02 16 25
				15 00 00 00 00 00 02 17 9D
				15 00 00 00 00 00 02 18 9A
				15 00 00 00 00 00 02 19 97
				15 00 00 00 00 00 02 1A 94
				15 00 00 00 00 00 02 1B 91
				15 00 00 00 00 00 02 1C 8E
				15 00 00 00 00 00 02 1D 8B
				15 00 00 00 00 00 02 1E 89
				15 00 00 00 00 00 02 1F 86
				15 00 00 00 00 00 02 20 83
				15 01 00 00 00 00 02 FF 22
				15 00 00 00 00 00 02 00 0A
				15 00 00 00 00 00 02 01 43
				15 00 00 00 00 00 02 02 5B
				15 00 00 00 00 00 02 03 6A
				15 00 00 00 00 00 02 04 7A
				15 00 00 00 00 00 02 05 82
				15 00 00 00 00 00 02 06 85
				15 00 00 00 00 00 02 07 80
				15 00 00 00 00 00 02 08 7C
				15 00 00 00 00 00 02 09 7C
				15 00 00 00 00 00 02 0A 74
				15 00 00 00 00 00 02 0B 71
				15 00 00 00 00 00 02 0C 6E
				15 00 00 00 00 00 02 0D 68
				15 00 00 00 00 00 02 0E 65
				15 01 00 00 00 00 02 0F 5C
				15 00 00 00 00 00 02 10 32
				15 00 00 00 00 00 02 11 18
				15 00 00 00 00 00 02 12 00
				15 00 00 00 00 00 02 13 00
				15 00 00 00 00 00 02 1A 00
				15 00 00 00 00 00 02 1B 00
				15 00 00 00 00 00 02 1C 00
				15 00 00 00 00 00 02 1D 00
				15 00 00 00 00 00 02 1E 00
				15 00 00 00 00 00 02 1F 00
				15 00 00 00 00 00 02 20 00
				15 00 00 00 00 00 02 21 00
				15 00 00 00 00 00 02 22 00
				15 00 00 00 00 00 02 23 00
				15 00 00 00 00 00 02 24 00
				15 01 00 00 00 00 02 25 00
				15 00 00 00 00 00 02 26 00
				15 00 00 00 00 00 02 27 00
				15 00 00 00 00 00 02 28 00
				15 00 00 00 00 00 02 29 00
				15 00 00 00 00 00 02 2A 00
				15 00 00 00 00 00 02 2B 00
				15 00 00 00 00 00 02 2F 00
				15 00 00 00 00 00 02 30 00
				15 00 00 00 00 00 02 31 00
				15 00 00 00 00 00 02 32 0C
				15 00 00 00 00 00 02 33 0C
				15 00 00 00 00 00 02 34 0C
				15 00 00 00 00 00 02 35 0B
				15 00 00 00 00 00 02 36 09
				15 00 00 00 00 00 02 37 09
				15 01 00 00 00 00 02 38 08
				15 00 00 00 00 00 02 39 05
				15 00 00 00 00 00 02 3A 03
				15 00 00 00 00 00 02 3B 00
				15 00 00 00 00 00 02 3F 00
				15 00 00 00 00 00 02 40 00
				15 00 00 00 00 00 02 41 00
				15 00 00 00 00 00 02 42 00
				15 00 00 00 00 00 02 43 00
				15 00 00 00 00 00 02 44 00
				15 00 00 00 00 00 02 45 00
				15 00 00 00 00 00 02 46 00
				15 00 00 00 00 00 02 47 00
				15 00 00 00 00 00 02 48 00
				15 00 00 00 00 00 02 49 03
				15 00 00 00 00 00 02 4A 06
				15 01 00 00 00 00 02 4B 07
				15 00 00 00 00 00 02 4C 07
				15 00 00 00 00 00 02 4D 00
				15 00 00 00 00 00 02 4E 00
				15 00 00 00 00 00 02 4F 00
				15 00 00 00 00 00 02 50 00
				15 00 00 00 00 00 02 51 00
				15 00 00 00 00 00 02 52 00
				15 00 00 00 00 00 02 53 01
				15 00 00 00 00 00 02 54 01
				15 00 00 00 00 00 02 55 89
				15 00 00 00 00 00 02 56 00
				15 00 00 00 00 00 02 58 00
				15 00 00 00 00 00 02 68 00
				15 00 00 00 00 00 02 84 FF
				15 00 00 00 00 00 02 85 FF
				15 01 00 00 00 00 02 86 03
				15 00 00 00 00 00 02 87 00
				15 00 00 00 00 00 02 88 00
				15 00 00 00 00 00 02 A2 20
				15 00 00 00 00 00 02 A9 01
				15 00 00 00 00 00 02 AA 12
				15 00 00 00 00 00 02 AB 13
				15 00 00 00 00 00 02 AC 0A
				15 00 00 00 00 00 02 AD 74
				15 00 00 00 00 00 02 AF 33
				15 00 00 00 00 00 02 B0 03
				15 00 00 00 00 00 02 B1 14
				15 00 00 00 00 00 02 B2 42
				15 00 00 00 00 00 02 B3 40
				15 00 00 00 00 00 02 B4 A5
				15 01 00 00 00 00 02 B6 44
				15 00 00 00 00 00 02 B7 04
				15 00 00 00 00 00 02 B8 14
				15 00 00 00 00 00 02 B9 42
				15 00 00 00 00 00 02 BA 40
				15 00 00 00 00 00 02 BB A5
				15 00 00 00 00 00 02 BD 44
				15 00 00 00 00 00 02 BE 04
				15 00 00 00 00 00 02 BF 00
				15 00 00 00 00 00 02 C0 75
				15 00 00 00 00 00 02 C1 6A
				15 00 00 00 00 00 02 C2 A5
				15 00 00 00 00 00 02 C4 22
				15 00 00 00 00 00 02 C5 02
				15 00 00 00 00 00 02 C6 00
				15 01 00 00 00 00 02 C7 95
				15 00 00 00 00 00 02 C8 8A
				15 00 00 00 00 00 02 C9 A5
				15 00 00 00 00 00 02 CB 22
				15 00 00 00 00 00 02 CC 02
				15 00 00 00 00 00 02 CD 00
				15 00 00 00 00 00 02 CE B5
				15 00 00 00 00 00 02 CF AA
				15 00 00 00 00 00 02 D0 A5
				15 00 00 00 00 00 02 D2 22
				15 00 00 00 00 00 02 D3 02
				15 01 00 00 00 00 02 FB 01
				15 01 00 00 00 00 02 FF 10
				15 01 00 00 00 00 02 26 02
				15 00 00 00 00 00 02 35 00
				15 00 00 00 00 00 02 51 FF
				15 00 00 00 00 00 02 53 24
				15 00 00 00 00 00 02 55 00
				15 01 00 00 00 00 02 B0 00
				05 01 00 00 50 00 02 11 00
				05 01 00 00 14 00 02 29 00
		];
		qcom,mdss-dsi-off-command = [
				05 01 00 00 00 00 02 28 00
				05 01 00 00 46 00 02 10 00];
		qcom,mdss-dsi-on-command-state = "dsi_lp_mode";
		qcom,mdss-dsi-off-command-state = "dsi_hs_mode";
		qcom,mdss-dsi-h-sync-pulse = <1>;
		qcom,mdss-dsi-traffic-mode = "burst_mode";
		qcom,mdss-dsi-bllp-eof-power-mode;
		qcom,mdss-dsi-bllp-power-mode;
		qcom,mdss-dsi-lp11-init;
		qcom,mdss-dsi-lane-0-state;
		qcom,mdss-dsi-lane-1-state;
		qcom,mdss-dsi-lane-2-state;
		qcom,mdss-dsi-lane-3-state;
		qcom,mdss-dsi-panel-timings = [00 1F 08 08 24 22 08 08 05 03 04 00];
		qcom,mdss-dsi-t-clk-post = <0x0D>;
		qcom,mdss-dsi-t-clk-pre = <0x30>;
		qcom,mdss-dsi-bl-min-level = <1>;
		qcom,mdss-dsi-bl-max-level = <4095>;
		qcom,mdss-brightness-max-level = <4095>;
		qcom,mdss-dsi-dma-trigger = "trigger_sw";
		qcom,mdss-dsi-mdp-trigger = "none";
		qcom,mdss-dsi-bl-pmic-control-type = "bl_ctrl_wled";
		qcom,mdss-dsi-reset-sequence = <0 10>, <1 10>;
		qcom,mdss-pan-physical-width-dimension = <68>;
		qcom,mdss-pan-physical-height-dimension = <136>;
		qcom,cont-splash-enabled;
		qcom,mdss-dsi-tx-eot-append;
		qcom,mdss-dsi-min-refresh-rate = <55>;
		qcom,mdss-dsi-max-refresh-rate = <60>;
		qcom,mdss-dsi-pan-enable-dynamic-fps;
		qcom,mdss-dsi-pan-fps-update = "dfps_immediate_porch_mode_vfp";
	};
};
